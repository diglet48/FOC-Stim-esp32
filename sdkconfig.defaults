## sdkconfig.defaults
```kconfig
# enable power management (DFS)
CONFIG_PM_ENABLE=y

# enable loglevel control
CONFIG_LOG_MASTER_LEVEL=y

#CONFIG_TINYUSB_MSC_ENABLED=y
#
#CONFIG_PARTITION_TABLE_CUSTOM=y
#CONFIG_PARTITION_TABLE_CUSTOM_FILENAME="focstimv3-partitions.csv"
#CONFIG_PARTITION_TABLE_FILENAME="focstimv3-partitions.csv"
#CONFIG_ESPTOOLPY_FLASHSIZE_4MB=y
#CONFIG_WL_SECTOR_SIZE_512=y
#CONFIG_WL_SECTOR_MODE_PERF=y
#
#CONFIG_FATFS_LFN_HEAP=y
#
#
#CONFIG_TINYUSB_CDC_ENABLED=y
#CONFIG_TINYUSB_DESC_USE_DEFAULT_PID=y
```
